// SPDX-License-Identifier: GPL-2.0
/*
 * Copyright (c) 2024 Codasip GmbH
 *
 * X730 MP4 CPU default configuration dtsi file for qemu.
 *
 * The current version of qemu which supports the CHERI extensions
 * does not support zicbom, zicboz or zicbop extensions.
 */

#include "a730-mp4.dtsi"

&cpu0 {
	riscv,isa = "rv64imafdc_svpbmt_zcheripurecap_zcherihybrid";
	riscv,isa-extensions = "i", "m", "a", "f", "d", "c",
			       "svpbmt",
			       "zcheripurecap", "zcherihybrid";
};

&cpu1 {
	riscv,isa = "rv64imafdc_svpbmt_zcheripurecap_zcherihybrid";
	riscv,isa-extensions = "i", "m", "a", "f", "d", "c",
			       "svpbmt",
			       "zcheripurecap", "zcherihybrid";
};

&cpu2 {
	riscv,isa = "rv64imafdc_svpbmt_zcheripurecap_zcherihybrid";
	riscv,isa-extensions = "i", "m", "a", "f", "d", "c",
			       "svpbmt",
			       "zcheripurecap", "zcherihybrid";
};

&cpu3 {
	riscv,isa = "rv64imafdc_svpbmt_zcheripurecap_zcherihybrid";
	riscv,isa-extensions = "i", "m", "a", "f", "d", "c",
			       "svpbmt",
			       "zcheripurecap", "zcherihybrid";
};
