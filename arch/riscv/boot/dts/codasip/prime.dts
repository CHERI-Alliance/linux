// SPDX-License-Identifier: (GPL-2.0 OR MIT)
/*
 * Copyright (c) 2025 Codasip GmbH
 *
 * Codasip Prime FPGA platform on VCU118
 */

/dts-v1/;

/{
	model = "Codasip Prime X730-MP4-Lux";
	compatible = "codasip,prime", "codasip,hobgoblin2-vcu118", "codasip,x730-lux", "codasip,x730", "codasip,a730";
	chosen {
		stdout-path = "serial0:115200n8";
		bootargs = "earlycon console=ttyS0,115200n8";
	};
};

#include "x730-lux.dtsi"
#include "hobgoblin2-base.dtsi"
#include "hobgoblin2-pcie.dtsi"
#include "hobgoblin2-vcu118-base.dtsi"
#include "hobgoblin2-vcu118-cmu.dtsi"

&i2c_fmcp_hspc {
	#address-cells = <1>;
	#size-cells = <0>;

	/* Opsero FPGADrive VITA57 EEPROM */
	fmcp_eeprom: eeprom@50 {
		compatible = "atmel,24c02";
		reg = <0x50>;
		pagesize = <16>;
		read-only;
	};
};
