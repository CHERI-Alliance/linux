// SPDX-License-Identifier: GPL-2.0
/*
 * Copyright (c) 2024 Codasip Limited
 *
 * A730 Hobgoblin FPGA platform emulation in qemu.
 */

#include "a70x-hobgoblin.dts"

&soc {
	axi_ethernetlite: ethernet@60020000 {
		compatible = "xlnx,xps-ethernetlite-3.00.a";
		device_type = "network";
		interrupts-extended = <&plic 15>;
		phy-handle = <&phy0>;
		reg = <0x60020000 0x2000>;
		xlnx,duplex = <0x1>;
		xlnx,include-global-buffers = <0x1>;
		xlnx,include-internal-loopback = <0x1>;
		xlnx,include-mdio = <0x1>;
		xlnx,instance = "axi_ethernetlite_inst";
		xlnx,rx-ping-pong = <0x1>;
		xlnx,s-axi-id-width = <0x0>;
		xlnx,tx-ping-pong = <0x1>;
		xlnx,use-internal = <0x0>;

		mdio {
			#address-cells = <1>;
			#size-cells = <0>;
			phy0: phy@1 {
				device_type = "ethernet-phy";
				reg = <1>;
			      };
		};
	};
};
