// SPDX-License-Identifier: (GPL-2.0 OR MIT)
/*
 * Copyright (c) 2025 Codasip GmbH
 *
 * A730 MP4 Hobgoblin FPGA platform for VCU118
 *
 * Uses onboard SGMII phy for Ethernet
 */

/dts-v1/;

/{
	chosen {
		stdout-path = "serial0:115200n8";
		bootargs = "earlycon console=ttyS0,115200n8";
	};
};

#include "a730-mp4.dtsi"
#include "hobgoblin2-base.dtsi"
#include "hobgoblin2-vcu118-base.dtsi"
