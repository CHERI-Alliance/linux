// SPDX-License-Identifier: GPL-2.0
/*
 * Copyright (c) 2024 Codasip GmbH
 *
 * A730 MP1 Hobgoblin FPGA platform for VCU118 Qemu
 */

/dts-v1/;

/{
	chosen {
		stdout-path = "serial0:115200n8";
		bootargs = "earlycon console=ttyS0,115200n8";
	};
};

#include "a730-mp1.dtsi"
#include "hobgoblin-base.dtsi"
#include "hobgoblin-vcu118-base.dtsi"
#include "hobgoblin-qemu-base.dtsi"
