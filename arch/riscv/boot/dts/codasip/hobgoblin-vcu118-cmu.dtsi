// SPDX-License-Identifier: GPL-2.0
/*
 * Copyright (c) 2025 Codasip GmbH
 *
 * Additions to the Hobgoblin FPGA VCU118 base description for systems
 * with a DCU. Currently this is only needed for the DRAM which is
 * reserved by the DCU for tag memory.
 */

/ {
	reserved-memory {
		#address-cells = <2>;
		#size-cells = <2>;
		ranges;

		cmu0: cmu@0f0000000 {
			reg = <0x0 0xf0000000 0x0 0x10000000>;
			no-map;
		};

		cmu1: cmu@170000000 {
			reg = <0x1 0x70000000 0x0 0x10000000>;
			no-map;
		};
	};
};
